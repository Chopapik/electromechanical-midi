// Generated by scripts/generate_hardware_profiles.py; edit JSON profiles, not this file.
#pragma once
#include <stdint.h>
namespace orchestra { namespace physical {
constexpr uint32_t fddStepLowUs = 30u;
constexpr uint32_t fddHomePeriodUs = 5000u;
constexpr uint32_t fddHomeTimeoutUs = 2000000u;
constexpr uint32_t hostWatchdogUs = 3000000u;
constexpr uint32_t spiClockHz = 1000000u;
constexpr uint32_t sledMinPeriodUs = 100u;
constexpr uint32_t fddProtocolMinHz = 40u;
constexpr uint32_t fddProtocolMaxHz = 500u;
constexpr uint32_t fddDirSetupUs = 5000u;
constexpr uint32_t sledRampMaxTickUs = 5000u;
constexpr uint32_t sledBrakingGuardSteps = 2u;
constexpr int32_t fddTravel[4] = {72, 72, 72, 72};
constexpr int32_t fddReversalUs[4] = {5000, 5000, 5000, 5000};
constexpr int32_t fddMinStepUs[4] = {2439, 2439, 2439, 2439};
constexpr int32_t sledTravel[4] = {140, 140, 140, 140};
constexpr float sledAcceleration[4] = {5000.0f, 5000.0f, 5000.0f, 5000.0f};
constexpr float sledPitchRatio[4] = {1.0f, 1.0f, 1.0f, 1.0f};
constexpr uint8_t sledAllowedBandCount[4] = {4, 0, 0, 0};
constexpr float sledAllowedBandsHz[4][4][2] = {{{50.0f, 120.0f}, {180.0f, 190.0f}, {270.0f, 300.0f}, {340.0f, 470.0f}}, {{0.0f, 0.0f}, {0.0f, 0.0f}, {0.0f, 0.0f}, {0.0f, 0.0f}}, {{0.0f, 0.0f}, {0.0f, 0.0f}, {0.0f, 0.0f}, {0.0f, 0.0f}}, {{0.0f, 0.0f}, {0.0f, 0.0f}, {0.0f, 0.0f}, {0.0f, 0.0f}}};
inline bool sledFrequencyAllowed(uint8_t id, float stepHz) {
 if (!sledAllowedBandCount[id]) return true;
 for (uint8_t i=0; i<sledAllowedBandCount[id]; ++i)
  if (stepHz>=sledAllowedBandsHz[id][i][0] && stepHz<=sledAllowedBandsHz[id][i][1]) return true;
 return false;
}
constexpr uint32_t hddParkUs[4] = {40000u, 40000u, 40000u, 40000u};
constexpr uint32_t hddSettleUs[4] = {40000u, 40000u, 40000u, 40000u};
constexpr uint32_t hddStrikeUs[4] = {4000u, 4000u, 4000u, 4000u};
}}
